## embedded/imager/Config.in
```kconfig
source "$BR2_EXTERNAL_IMAGER_PATH/package/rpi-imager/Config.in"
source "$BR2_EXTERNAL_IMAGER_PATH/package/rpi-firmware-custom/Config.in"
```

## embedded/imager/configs/rpi-imager_defconfig
```kconfig
BR2_aarch64=y
BR2_cortex_a72=y
BR2_PACKAGE_HOST_LINUX_HEADERS_CUSTOM_6_1=y
BR2_TOOLCHAIN_BUILDROOT_CXX=y
BR2_SSP_NONE=y
BR2_FORTIFY_SOURCE_NONE=y
BR2_INIT_NONE=y
BR2_ROOTFS_DEVICE_CREATION_DYNAMIC_EUDEV=y
BR2_ROOTFS_MERGED_USR=y
BR2_TARGET_GENERIC_ROOT_PASSWD="raspberry"
BR2_ROOTFS_OVERLAY="$(BR2_EXTERNAL_IMAGER_PATH)/board/overlay/"
BR2_ROOTFS_POST_BUILD_SCRIPT="$(BR2_EXTERNAL_IMAGER_PATH)/board/post-build.sh"
BR2_LINUX_KERNEL=y
BR2_LINUX_KERNEL_CUSTOM_TARBALL=y
BR2_LINUX_KERNEL_CUSTOM_TARBALL_LOCATION="$(call github,raspberrypi,linux,2a47ccf97c6a91bc56f8cfb387d47f59cc347dd5)/linux-2a47ccf97c6a91bc56f8cfb387d47f59cc347dd5.tar.gz"
BR2_LINUX_KERNEL_USE_CUSTOM_CONFIG=y
BR2_LINUX_KERNEL_CUSTOM_CONFIG_FILE="$(BR2_EXTERNAL_IMAGER_PATH)/board/bcm2711_defconfig_minus_modules"
BR2_LINUX_KERNEL_CONFIG_FRAGMENT_FILES="$(BR2_EXTERNAL_IMAGER_PATH)/board/kernel_config_fragment_imager"
BR2_LINUX_KERNEL_IMAGEGZ=y
BR2_LINUX_KERNEL_ZSTD=y
BR2_LINUX_KERNEL_DTS_SUPPORT=y
BR2_LINUX_KERNEL_INTREE_DTS_NAME="broadcom/bcm2711-rpi-4-b broadcom/bcm2711-rpi-400 broadcom/bcm2711-rpi-cm4 broadcom/bcm2712-rpi-5-b overlays/overlay_map overlays/dwc2-overlay overlays/vc4-kms-v3d-pi4-overlay overlays/vc4-kms-v3d-pi5-overlay overlays/disable-bt-overlay overlays/disable-wifi-overlay overlays/disable-bt-pi5-overlay overlays/disable-wifi-pi5-overlay"
BR2_PACKAGE_BUSYBOX_SHOW_OTHERS=y
BR2_PACKAGE_XZ=y
BR2_PACKAGE_MESA3D=y
BR2_PACKAGE_MESA3D_GALLIUM_DRIVER_V3D=y
BR2_PACKAGE_MESA3D_OPENGL_ES=y
BR2_PACKAGE_QT5BASE_EGLFS=y
# BR2_PACKAGE_EUDEV_ENABLE_HWDB is not set
# BR2_PACKAGE_LIBOPENSSL_ENABLE_WEAK_SSL is not set
# BR2_PACKAGE_LIBOPENSSL_UNSECURE is not set
# BR2_PACKAGE_LIBOPENSSL_DYNAMIC_ENGINE is not set
# BR2_PACKAGE_LIBOPENSSL_ENABLE_COMP is not set
BR2_PACKAGE_LIBCURL_VERBOSE=y
# BR2_PACKAGE_LIBCURL_PROXY_SUPPORT is not set
# BR2_PACKAGE_LIBCURL_EXTRA_PROTOCOLS_FEATURES is not set
BR2_PACKAGE_DHCPCD=y
# BR2_PACKAGE_IFUPDOWN_SCRIPTS is not set
BR2_PACKAGE_UTIL_LINUX_BINARIES=y
BR2_TARGET_ROOTFS_CPIO=y
BR2_TARGET_ROOTFS_CPIO_ZSTD=y
# BR2_TARGET_ROOTFS_TAR is not set
BR2_PACKAGE_RPI_IMAGER=y
BR2_PACKAGE_RPI_FIRMWARE_CUSTOM=y
```

## embedded/imager/package/rpi-firmware-custom/Config.in
```kconfig
config BR2_PACKAGE_RPI_FIRMWARE_CUSTOM
	bool "rpi-firmware"
	depends on BR2_arm
	help
	  RaspberryPi Firmware
	  Pre-compiled binaries of the current bootloader and GPU firmware

	  https://github.com/raspberrypi/firmware

if BR2_PACKAGE_RPI_FIRMWARE_CUSTOM

choice
	bool "Firmware to boot"
	default BR2_PACKAGE_RPI_FIRMWARE_CUSTOM_DEFAULT
	help
	  There are three different firmware files:
	    - the default firmware, that enables standard GPU features;
	    - the extended firmware, that enables additional GPU features
	      (eg. more audio/video codecs);
	    - the cut-down firmware, for emergency situations, with only
	      features required to boot a Linux kernel.

config BR2_PACKAGE_RPI_FIRMWARE_CUSTOM_DEFAULT
	bool "default"
	help
	  The default firmware, that enables standard GPU features.

config BR2_PACKAGE_RPI_FIRMWARE_CUSTOM_X
	bool "extended ('x', more codecs)"
	help
	  The extended firmware, that enables additional GPU features
	  (eg. more audio/video codecs).

config BR2_PACKAGE_RPI_FIRMWARE_CUSTOM_CD
	bool "cut-down ('cd', emergency)"
	help
	  The cut-down firmware, for emergency situations, with only
	  features required to boot a Linux kernel.

endchoice

config BR2_PACKAGE_RPI_FIRMWARE_CUSTOM_BOOT
	string
	default ""      if BR2_PACKAGE_RPI_FIRMWARE_CUSTOM_DEFAULT
	default "_x"    if BR2_PACKAGE_RPI_FIRMWARE_CUSTOM_X
	default "_cd"   if BR2_PACKAGE_RPI_FIRMWARE_CUSTOM_CD

endif # BR2_PACKAGE_RPI_FIRMWARE_CUSTOM
```

## embedded/imager/package/rpi-imager/Config.in
```kconfig
config BR2_PACKAGE_RPI_IMAGER
        bool "rpi-imager"
        select BR2_PACKAGE_QT5
        select BR2_PACKAGE_QT5BASE_GUI
        select BR2_PACKAGE_QT5BASE_CONCURRENT
        select BR2_PACKAGE_QT5BASE_JPEG
        select BR2_PACKAGE_QT5BASE_PNG
        select BR2_PACKAGE_QT5SVG
        select BR2_PACKAGE_QT5QUICKCONTROLS2
        select BR2_PACKAGE_LIBCURL
        select BR2_PACKAGE_LIBARCHIVE
        select BR2_PACKAGE_ZSTD        
        select BR2_PACKAGE_DOSFSTOOLS
        select BR2_PACKAGE_DOSFSTOOLS_MKFS_FAT
        select BR2_PACKAGE_OPENSSL
        select BR2_PACKAGE_CA_CERTIFICATES
        select BR2_PACKAGE_QT5TOOLS
        select BR2_PACKAGE_QT5TOOLS_LINGUIST_TOOLS
        
        help
          Raspberry Pi Imager
```
